/ {
    chosen {
        zephyr,console = &cdc_acm_uart0;
        uart,gps = &uart1;
    };
};

&zephyr_udc0 {
    cdc_acm_uart0: cdc_acm_uart0 {
    	compatible = "zephyr,cdc-acm-uart";
        label = "CDC_ACM_0";
    };
};
