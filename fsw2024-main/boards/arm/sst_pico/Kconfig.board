## fsw2024-main/boards/arm/sst_pico/Kconfig.board
```kconfig
# Copyright (c) 2021 Yonatan Schachter
# SPDX-License-Identifier: Apache-2.0

config BOARD_SST_PICO
	bool "SST Raspberry Pi Pico Board"
	depends on SOC_RP2040
```

## fsw2024-main/drivers/gnss/Kconfig
```kconfig
# GNSS configuration options

# Copyright (c) 2022 Abel Sensors
# SPDX-License-Identifier: Apache-2.0


menu "OOT Sensor Drivers"

rsource "ublox-neo-m8/Kconfig"

endmenu
```
